## app/boards/sf32lb52-superkey/lcpu/Kconfig.board
```kconfig
config BSP_USING_BOARD_SF32LB52_SUPERKEY
    bool
    select SOC_SF32LB52X
    select BF0_LCPU
    default y

rsource "../Kconfig.board"
```

## app/project/Kconfig.tmp
```kconfig
source "D:/program/SuperKey/app/boards/sf32lb52-superkey/hcpu/Kconfig.board"
source "$SIFLI_SDK/customer/boards/Kconfig.v2"
source "$SIFLI_SDK/Kconfig.v2"
orsource "sf-pkgs/Kconfig.conandeps"
rsource "Kconfig.proj"
```
